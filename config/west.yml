## config/west.yml
```yaml
manifest:
  remotes:
    - name: moergo-sc
      url-base: https://github.com/moergo-sc
    - name: IntenseWiggling
      url-base: https://github.com/IntenseWiggling
  projects:
    - name: zmk
      remote: moergo-sc
      revision: main
      import: app/west.yml
    - name: zmk-trackball-gestures-module
      remote: IntenseWiggling
      revision: master
  self:
    path: config
```
